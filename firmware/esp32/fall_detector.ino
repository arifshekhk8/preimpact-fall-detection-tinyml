/*
 * Pre-impact fall detector -- ESP32 + MPU6050, TFLite Micro, INT8.
 *
 * This firmware mirrors fdlib/preprocess.py step for step. If the two ever diverge,
 * the model scores well in Python and behaves randomly here, and the failure is
 * extremely hard to diagnose from the device side.
 *
 * Pipeline, matching the training contract exactly:
 *   50 Hz hardware timer ISR -> ring buffer of raw counts
 *   every 25 new samples (0.5 s stride):
 *       copy a 100 x 6 window
 *       convert to g and deg/s
 *       normalise each window by its own per-channel mean and variance
 *       quantise with the model's own scale and zero point
 *       invoke
 *       dequantise, threshold, fire the buzzer
 *
 * Sensor configuration, per section 8.2:
 *   accelerometer +/-16 g   -- impacts routinely exceed 8 g and a clipped peak is an
 *                              unrecoverable loss of exactly the signal we want
 *   gyroscope     +/-2000 dps
 *   I2C           400 kHz   -- 100 kHz leaves too little headroom at 50 Hz
 *
 * The sampling is timer-driven, NOT delay(20). Loop delay jitter accumulates and
 * shifts window content relative to what the model was trained on.
 */

#include <Wire.h>

#include "model.h"            // generated by fdlib.tflite_export.to_c_array
// norm_constants.h is no longer compiled in: normalisation is per-window (see loop()).
// The header is still generated by nb01/nb06 and kept in the repo as the record of
// what the global constants were, should a future variant need them again.

#include <TensorFlowLite_ESP32.h>
#include "tensorflow/lite/micro/all_ops_resolver.h"
#include "tensorflow/lite/micro/micro_error_reporter.h"
#include "tensorflow/lite/micro/micro_interpreter.h"
#include "tensorflow/lite/schema/schema_generated.h"

// ------------------------------------------------------------------ contract
// These MUST match fdlib.config. A mismatch is silent and fatal.
static const int   kSampleRateHz = 50;
static const int   kWindowLen    = 100;   // 2.0 s
static const int   kStride       = 25;    // 0.5 s
static const int   kChannels     = 6;
static const int   kNumClasses   = 3;     // bkg, alert, fall
static const float kThreshold    = 0.70f; // from the E3 operating-point sweep
static const uint32_t kCooldownMs = 5000;

// MPU6050
static const uint8_t kMpuAddr     = 0x68;
static const int     kPinBuzzer   = 4;
static const int     kPinSDA      = 21;
static const int     kPinSCL      = 22;

// +/-16 g over 16 bits, +/-2000 dps over 16 bits
static const float kAccelScale = 16.0f / 32768.0f;
static const float kGyroScale  = 2000.0f / 32768.0f;

// ---------------------------------------------------------------- ring buffer
static volatile int16_t  gRing[kWindowLen][kChannels];
static volatile uint32_t gWriteIdx = 0;
static volatile uint32_t gNewSamples = 0;
static portMUX_TYPE gMux = portMUX_INITIALIZER_UNLOCKED;
static hw_timer_t *gTimer = nullptr;

// ------------------------------------------------------------------- TFLite
constexpr int kArenaSize = 40 * 1024;   // tune DOWN after reading the high-water mark
static uint8_t gArena[kArenaSize];

static tflite::MicroErrorReporter gErrorReporter;
static tflite::MicroInterpreter  *gInterpreter = nullptr;
static TfLiteTensor              *gInput = nullptr;
static TfLiteTensor              *gOutput = nullptr;

// measurement accumulators for contribution C3
static uint64_t gLatencySumUs = 0;
static uint32_t gInferenceCount = 0;

// ----------------------------------------------------------------- MPU6050
static void mpuWrite(uint8_t reg, uint8_t val) {
  Wire.beginTransmission(kMpuAddr);
  Wire.write(reg);
  Wire.write(val);
  Wire.endTransmission();
}

static void mpuInit() {
  mpuWrite(0x6B, 0x00);  // wake
  delay(100);
  mpuWrite(0x1C, 0x18);  // ACCEL_CONFIG: AFS_SEL=3 -> +/-16 g
  mpuWrite(0x1B, 0x18);  // GYRO_CONFIG:  FS_SEL=3  -> +/-2000 dps
  mpuWrite(0x1A, 0x03);  // DLPF 44 Hz -- analogue anti-alias ahead of the 50 Hz sampler
  delay(50);
}

static void mpuRead(int16_t *out6) {
  Wire.beginTransmission(kMpuAddr);
  Wire.write(0x3B);
  Wire.endTransmission(false);
  Wire.requestFrom((int)kMpuAddr, 14, true);
  int16_t ax = (Wire.read() << 8) | Wire.read();
  int16_t ay = (Wire.read() << 8) | Wire.read();
  int16_t az = (Wire.read() << 8) | Wire.read();
  Wire.read(); Wire.read();               // temperature, discarded
  int16_t gx = (Wire.read() << 8) | Wire.read();
  int16_t gy = (Wire.read() << 8) | Wire.read();
  int16_t gz = (Wire.read() << 8) | Wire.read();
  out6[0] = ax; out6[1] = ay; out6[2] = az;
  out6[3] = gx; out6[4] = gy; out6[5] = gz;
}

// --------------------------------------------------------------------- ISR
void IRAM_ATTR onTimer() {
  portENTER_CRITICAL_ISR(&gMux);
  gNewSamples++;
  portEXIT_CRITICAL_ISR(&gMux);
}

static volatile bool gSampleDue = false;
void IRAM_ATTR onSampleTimer() { gSampleDue = true; }

// ------------------------------------------------------------------- setup
void setup() {
  Serial.begin(115200);
  pinMode(kPinBuzzer, OUTPUT);
  digitalWrite(kPinBuzzer, LOW);

  Wire.begin(kPinSDA, kPinSCL);
  Wire.setClock(400000);   // 400 kHz -- section 8.2
  mpuInit();

  const tflite::Model *model = tflite::GetModel(g_model);
  if (model->version() != TFLITE_SCHEMA_VERSION) {
    Serial.println("FATAL: model schema mismatch");
    while (true) delay(1000);
  }
  static tflite::AllOpsResolver resolver;
  static tflite::MicroInterpreter interpreter(model, resolver, gArena, kArenaSize,
                                              &gErrorReporter);
  gInterpreter = &interpreter;
  if (gInterpreter->AllocateTensors() != kTfLiteOk) {
    Serial.println("FATAL: AllocateTensors failed -- increase kArenaSize");
    while (true) delay(1000);
  }
  gInput  = gInterpreter->input(0);
  gOutput = gInterpreter->output(0);

  Serial.printf("input  scale %.8f zero_point %d\n",
                gInput->params.scale, gInput->params.zero_point);
  Serial.printf("output scale %.8f zero_point %d\n",
                gOutput->params.scale, gOutput->params.zero_point);
  Serial.printf("arena used at init: %u bytes of %u\n",
                (unsigned)gInterpreter->arena_used_bytes(), (unsigned)kArenaSize);

  // 50 Hz hardware timer. Never delay(20) in loop() -- jitter accumulates and
  // shifts window content relative to training.
  gTimer = timerBegin(0, 80, true);              // 80 prescaler -> 1 MHz tick
  timerAttachInterrupt(gTimer, &onSampleTimer, true);
  timerAlarmWrite(gTimer, 1000000 / kSampleRateHz, true);
  timerAlarmEnable(gTimer);

  Serial.println("ready");
}

// -------------------------------------------------------------------- loop
static uint32_t gLastAlarmMs = 0;

void loop() {
  if (gSampleDue) {
    gSampleDue = false;
    int16_t s[kChannels];
    mpuRead(s);
    uint32_t idx = gWriteIdx % kWindowLen;
    for (int c = 0; c < kChannels; c++) gRing[idx][c] = s[c];
    gWriteIdx++;
    gNewSamples++;
  }

  if (gNewSamples < (uint32_t)kStride || gWriteIdx < (uint32_t)kWindowLen) return;
  gNewSamples = 0;

  // --- copy the window oldest-first, convert units, normalise, quantise ---
  //
  // Normalisation is PER WINDOW, not against the frozen global constants. Two
  // reasons, and both are load-bearing:
  //
  //  1. Quantisation. Keeping instance normalisation as a layer inside the graph
  //     destroyed the INT8 model on the desktop -- macro-F1 fell from 0.660 to
  //     0.184 with only 31 % agreement against FP32 -- because per-window mean and
  //     variance produce intermediate tensors whose dynamic range a single global
  //     scale cannot represent. Doing it here, in float, before quantising, removes
  //     that op from the graph entirely.
  //  2. Generalisation. E2 found per-window instance normalisation to be the only
  //     domain-adaptation method that helped across datasets, and the cheapest.
  //
  // The exported model is trained on instance-normalised windows, so this loop and
  // fdlib.preprocess.instance_normalise must stay identical.
  const float inScale = gInput->params.scale;
  const int   inZero  = gInput->params.zero_point;
  uint32_t start = gWriteIdx % kWindowLen;

  static float win[kWindowLen][kChannels];

  // pass 1: raw counts -> g and deg/s
  for (int t = 0; t < kWindowLen; t++) {
    uint32_t r = (start + t) % kWindowLen;
    for (int c = 0; c < kChannels; c++) {
      win[t][c] = (float)gRing[r][c] * (c < 3 ? kAccelScale : kGyroScale);
    }
  }

  // pass 2: per-channel mean and variance over this window
  for (int c = 0; c < kChannels; c++) {
    float mean = 0.0f;
    for (int t = 0; t < kWindowLen; t++) mean += win[t][c];
    mean /= (float)kWindowLen;

    float var = 0.0f;
    for (int t = 0; t < kWindowLen; t++) {
      const float d = win[t][c] - mean;
      var += d * d;
    }
    var /= (float)kWindowLen;
    const float inv = 1.0f / (sqrtf(var) + 1e-6f);   // matches instance_normalise's eps

    // pass 3: normalise and quantise with the model's own parameters
    for (int t = 0; t < kWindowLen; t++) {
      const float v = (win[t][c] - mean) * inv;
      int q = (int)lroundf(v / inScale) + inZero;
      if (q < -128) q = -128;
      if (q >  127) q =  127;
      gInput->data.int8[t * kChannels + c] = (int8_t)q;
    }
  }

  int64_t t0 = esp_timer_get_time();
  TfLiteStatus st = gInterpreter->Invoke();
  int64_t t1 = esp_timer_get_time();
  if (st != kTfLiteOk) { Serial.println("Invoke failed"); return; }

  gLatencySumUs += (uint64_t)(t1 - t0);
  gInferenceCount++;

  // --- dequantise ---
  const float outScale = gOutput->params.scale;
  const int   outZero  = gOutput->params.zero_point;
  float p[kNumClasses];
  for (int i = 0; i < kNumClasses; i++) {
    p[i] = ((int)gOutput->data.int8[i] - outZero) * outScale;
  }
  float pAlarm = p[1] + p[2];   // alert + fall, as in the Python binary metrics

  uint32_t now = millis();
  if (pAlarm >= kThreshold && (now - gLastAlarmMs) > kCooldownMs) {
    gLastAlarmMs = now;
    digitalWrite(kPinBuzzer, HIGH);
    Serial.printf("ALARM p_alert=%.3f p_fall=%.3f latency_us=%lld\n",
                  p[1], p[2], (long long)(t1 - t0));
    delay(400);
    digitalWrite(kPinBuzzer, LOW);
  }

  // --- C3 measurement: report every 1000 inferences, per section 9 step 5 ---
  if (gInferenceCount % 1000 == 0) {
    Serial.printf("MEASURE inferences=%u mean_latency_us=%llu mean_latency_ms=%.3f "
                  "arena_used=%u arena_size=%u\n",
                  gInferenceCount,
                  (unsigned long long)(gLatencySumUs / gInferenceCount),
                  (double)gLatencySumUs / gInferenceCount / 1000.0,
                  (unsigned)gInterpreter->arena_used_bytes(),
                  (unsigned)kArenaSize);
  }
}
